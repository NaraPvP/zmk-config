## config/boards/shields/Hold_IT/Kconfig.defconfig
```kconfig
if SHIELD_HOLD_IT_LEFT

config ZMK_KEYBOARD_NAME
    default "Hold-IT!"

config ZMK_SPLIT_BLE_ROLE_CENTRAL
    default y

endif

if SHIELD_HOLD_IT_LEFT || SHIELD_HOLD_IT_RIGHT

config ZMK_SPLIT
    default y

endif
```

## config/boards/shields/Hold_IT/Kconfig.shield
```kconfig
config SHIELD_HOLD_IT_LEFT
    def_bool $(shields_list_contains,hold_it_left)

config SHIELD_HOLD_IT_RIGHT
    def_bool $(shields_list_contains,hold_it_right)
```
